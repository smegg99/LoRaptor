## sdkconfig.defaults
```kconfig
CONFIG_ESP_CONSOLE_USB_CDC=y
CONFIG_USB_OTG_SUPPORTED=y
CONFIG_ESP_CONSOLE_SECONDARY_USB=y
CONFIG_ESP_CONSOLE_USB_CDC_ENABLED=y
CONFIG_USB_ENABLED=y
CONFIG_TINYUSB_ENABLED=y
CONFIG_TINYUSB_CDC_ENABLED=y
```
